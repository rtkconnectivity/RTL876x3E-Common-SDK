## board/evb/ota_demo/Kconfig
```kconfig
#
# Copyright (c) 2026, Realtek Semiconductor Corporation
#
# SPDX-License-Identifier: LicenseRef-Realtek-5-Clause
#
mainmenu "realtek otademo mainmenu"

menu "otademo"
rsource "../../../src/Kconfig"
endmenu

config REALTEK_APP_OTA_DEMO
   bool
   default y
rsource "../../../Kconfig"
```

## board/evb/usb_demo/Kconfig
```kconfig
#
# Copyright (c) 2026, Realtek Semiconductor Corporation
#
# SPDX-License-Identifier: LicenseRef-Realtek-5-Clause
#
mainmenu "realtek usbDemo mainmenu"

menu "usbDemo"
rsource "../../../src/Kconfig"
endmenu

config REALTEK_USB_AUDIO_APP
   bool "USB Audio"
   default n
   
config REALTEK_USB_AUDIO_ENABLE
   bool "Enable USB Audio"
   depends on REALTEK_USB_AUDIO_APP

config REALTEK_USB_HID_APP
   bool "USB HID"
   default n
   
config REALTEK_USB_HID_ENABLE
   bool "Enable HID Audio"
   depends on REALTEK_USB_HID_APP

rsource "../../../Kconfig"
```

## src/sample/Kconfig
```kconfig
#
# Copyright (c) 2026, Realtek Semiconductor Corporation
#
# SPDX-License-Identifier: LicenseRef-Realtek-5-Clause
#
rsource "./common/Kconfig"
menuconfig REALTEK_GUI
   bool "GUI config"
   default n

if REALTEK_GUI
orsource "./gui/Kconfig.gui"
endif
```
