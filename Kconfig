## Kconfig
```kconfig
#
# Copyright (c) 2026, Realtek Semiconductor Corporation
#
# SPDX-License-Identifier: LicenseRef-Realtek-5-Clause
#
menu "board option"

config SOC_SERIES_RTL8763E
	bool "RTL8763E"
	default y
rsource "./bin/rtl87x3e/Kconfig.board"

endmenu

if SOC_SERIES_RTL8763E
config REALTEK_SOC_SERIES_NAME
   string
   default "RTL8763E"
config SOC_SERIES_RTL8763E_V2
   bool
   default y
   help
     RTL8763E V2
endif

if SOC_SERIES_RTL8763E
rsource "Kconfig.RTL8763E.sdk"
endif
```

## Kconfig.RTL8763E.sdk
```kconfig
#
# Copyright (c) 2026, Realtek Semiconductor Corporation
#
# SPDX-License-Identifier: LicenseRef-Realtek-5-Clause
#
rsource "./bin/rtl87x3e/Kconfig.soc.sdk"
```

## bin/rtl87x3e/Kconfig.board
```kconfig
#
# Copyright (c) 2026, Realtek Semiconductor Corporation
#
# SPDX-License-Identifier: LicenseRef-Realtek-5-Clause
#
if SOC_SERIES_RTL8763E
choice SOC_RTL8763E_PARTNUMBER
    prompt "select RTL8763E partnumber"

config SOC_RTL8763EAU
    bool "RTL8763EAU"

config SOC_RTL8763ESE
    bool "RTL8763ESE"

config SOC_RTL8763EFL
    bool "RTL8763EFL"

config SOC_RTL8763ESL
    bool "RTL8763ESL"

config SOC_RTL8763EHA
    bool "RTL8763EHA"

config SOC_RTL8763EF
    bool "RTL8763EF"

config SOC_RTL8763EW
    bool "RTL8763EW"

config SOC_RTL8763EW_VC
    bool "RTL8763EW-VC"

config SOC_RTL8763EW_VP
    bool "RTL8763EW-VP"

config SOC_RTL8763EWE
    bool "RTL8763EWE"

config SOC_RTL8763EWE_VP
    bool "RTL8763EWE-VP"
endchoice


config REALTEK_TARGET_RTL8763EAU
    int
    default 1 if SOC_RTL8763EAU
    default 0
    help
       TARGET_RTL8763EAU

config REALTEK_TARGET_RTL8763ESE
    int
    default 1 if SOC_RTL8763ESE
    default 0
    help
      TARGET_RTL8763ESE

config REALTEK_TARGET_RTL8763EFL
    int
    default 1 if SOC_RTL8763EFL
    default 0
    help
      TARGET_RTL8763EFL

config REALTEK_TARGET_RTL8763ESL
    int
    default 1 if SOC_RTL8763ESL
    default 0
    help
      TARGET_RTL8763ESL

config REALTEK_TARGET_RTL8763EHA
    int
    default 1 if SOC_RTL8763EHA
    default 0
    help
      TARGET_RTL8763EHA

config REALTEK_TARGET_RTL8763EF
    int
    default 1 if SOC_RTL8763EF
    default 0
    help
      TARGET_RTL8763EF

config REALTEK_TARGET_RTL8763EW
    int
    default 1 if SOC_RTL8763EW
    default 0
    help
      TARGET_RTL8763EW

config REALTEK_TARGET_RTL8763EW_VC
    int
    default 1 if SOC_RTL8763EW_VC
    default 0
    help
      TARGET_RTL8763EW_VC

config REALTEK_TARGET_RTL8763EW_VP
    int
    default 1 if SOC_RTL8763EW_VP
    default 0
    help
      TARGET_RTL8763EW_VP

config REALTEK_TARGET_RTL8763EWE
    int
    default 1 if SOC_RTL8763EWE
    default 0
    help
      TARGET_RTL8763EWE

config REALTEK_TARGET_RTL8763EWE_VP
    int
    default 1 if SOC_RTL8763EWE_VP
    default 0
    help
      TARGET_RTL8763EWE_VP

rsource "flash_map_config/Kconfig"

endif
```

## bin/rtl87x3e/Kconfig.soc.sdk
```kconfig
#
# Copyright (c) 2026, Realtek Semiconductor Corporation
#
# SPDX-License-Identifier: LicenseRef-Realtek-5-Clause
#
menuconfig REALTEK_HAL
   bool "hal config"
   depends on SOC_SERIES_RTL8763E

if REALTEK_HAL
config REALTEK_HAL_TARGET_NAME
    string
    default "libhal_utils"
endif

menuconfig REALTEK_BLE_MGR
   bool "ble mgr"

if REALTEK_BLE_MGR

choice REALTEK_BLE_MGR_TARGET
    prompt "target"
    default REALTEK_BLE_MGR_TARGET_DEFAULT

config  REALTEK_BLE_MGR_TARGET_DEFAULT
    bool "default"

    help
      build ble manager library target name for default

if REALTEK_BLE_MGR_TARGET_DEFAULT
config REALTEK_BLE_MGR_TARGET_NAME
    string
	default "libble_mgr_default"
endif

config  REALTEK_BLE_MGR_TARGET_ALL
    bool "all"
    help
      build le manager library target name for all

if REALTEK_BLE_MGR_TARGET_ALL
config REALTEK_BLE_MGR_TARGET_NAME
    string
    default "libble_mgr_all"
endif

config  REALTEK_BLE_MGR_TARGET_DONGLE
    bool "dongle"
    help
      build le manager library target name for dongle

if REALTEK_BLE_MGR_TARGET_DONGLE
config REALTEK_BLE_MGR_TARGET_NAME
    string
    default "libble_mgr_dongle"
endif

endchoice

endif

menuconfig REALTEK_BLE_AUDIO
   bool "ble audio"
   
if REALTEK_BLE_AUDIO

choice REALTEK_BLE_AUDIO_TARGET
    prompt "target"
    default REALTEK_BLE_AUDIO_TARGET_DEFAULT

config  REALTEK_BLE_AUDIO_TARGET_DEFAULT
    bool "default"

    help
      build le audio library target name for default

if REALTEK_BLE_AUDIO_TARGET_DEFAULT
config REALTEK_BLE_AUDIO_TARGET_NAME
    string
    default "libleaudio"
endif

config  REALTEK_BLE_AUDIO_TARGET_DONGLE
    bool "dongle"
    help
      build le audio library target name for dongle

if REALTEK_BLE_AUDIO_TARGET_DONGLE
config REALTEK_BLE_AUDIO_TARGET_NAME
    string
    default "libleaudio_dongle"
endif

endchoice

endif

menuconfig REALTEK_DUAL_AUDIO_EFFECT
   bool "dual audio effect"
   help
      use dual audio effect

if REALTEK_DUAL_AUDIO_EFFECT

config REALTEK_DUAL_AUDIO_EFFECT_TARGET_NAME
   string
   default "libdual_audio_effect"

endif

menuconfig REALTEK_ENGAGE
   bool "engage"
   help
      use engage function

if REALTEK_ENGAGE
config REALTEK_ENGAGE_TARGET_NAME
   string
   default "libengage"
endif

menuconfig REALTEK_FILESYSTEM
   bool "filesystem"
   help
      use filesystem function

if REALTEK_FILESYSTEM

config REALTEK_FILESYSTEM_TARGET_NAME
   string
   default "libfilesystem"

endif

menuconfig REALTEK_FRAMEWORK
   bool "framework"
   help
     framework library

if REALTEK_FRAMEWORK

choice REALTEK_FRAMEWORK_TARGET
    prompt "target"
	default REALTEK_FRAMEWORK_TARGET_DEFAULT

config  REALTEK_FRAMEWORK_TARGET_DEFAULT
    bool "default"

    help
      build framework library target name for default

if REALTEK_FRAMEWORK_TARGET_DEFAULT
config REALTEK_FRAMEWORK_TARGET_NAME
    string
    default "libframework_default"
endif

config  REALTEK_FRAMEWORK_TARGET_ALL
    bool "all"
    help
      build framework library target name for all

if REALTEK_FRAMEWORK_TARGET_ALL
config REALTEK_FRAMEWORK_TARGET_NAME
    string
    default "libframework_all"
endif

config  REALTEK_FRAMEWORK_TARGET_DURIAN
    bool "durian"
    help
      build framework library target name for durian

if REALTEK_FRAMEWORK_TARGET_DURIAN
config REALTEK_FRAMEWORK_TARGET_NAME
    string
    default "libframework_durian"
endif

config  REALTEK_FRAMEWORK_TARGET_STEREO
    bool "stereo"
    help
      build framework library target name for stereo

if REALTEK_FRAMEWORK_TARGET_STEREO
config REALTEK_FRAMEWORK_TARGET_NAME
    string
    default "libframework_stereo"
endif

config  REALTEK_FRAMEWORK_TARGET_WATCH
    bool "watch"
    help
      build framework library target name for watch

if REALTEK_FRAMEWORK_TARGET_WATCH
config REALTEK_FRAMEWORK_TARGET_NAME
    string
    default "libframework_watch"
endif

endchoice

endif

menuconfig REALTEK_CONSOLE
   bool "console"
   help
     framework console

if REALTEK_CONSOLE

config REALTEK_CONSOLE_TARGET_NAME
   string
   default "libconsole"

endif

menuconfig REALTEK_REMOTE
   bool "remote"
   help
     framework remote

if REALTEK_REMOTE

config REALTEK_REMOTE_TARGET_NAME
   string
   default "libremote"

endif

menuconfig REALTEK_SYSM
   bool "sysm"
   help
     framework sysm

if REALTEK_SYSM

config REALTEK_SYSM_TARGET_NAME
   string
   default "libsysm"

endif

menuconfig REALTEK_GAMING_BT
   bool "gaming bt"
   help
      gaming bt lib

if REALTEK_GAMING_BT

config REALTEK_GAMING_BT_TARGET_NAME
   string
   default "libgaming_bt"

endif


menuconfig REALTEK_GFPS
   bool "gfps"
   help
      gfps lib

if REALTEK_GFPS

config REALTEK_GFPS_TARGET_NAME
   string
   default "libgfps"

endif

menuconfig REALTEK_SD
   bool "sd"
   help
      use sd function

if REALTEK_SD

config REALTEK_SD_TARGET_NAME
   string
   default "libsd"

endif

menuconfig REALTEK_TEAMS
   bool "teams"
   help
      use teams function

if REALTEK_TEAMS

config REALTEK_TEAMS_TARGET_NAME
   string
   default "libteams"

endif

menuconfig REALTEK_USB
   bool "usb"
   help
      use usb function

if REALTEK_USB

config REALTEK_USB_TARGET_NAME
   string
   default "libusb"

endif

menuconfig REALTEK_USB_HAL
   bool "usb hal"
   help
      use usb hal

if REALTEK_USB_HAL

config REALTEK_USB_HAL_TARGET_NAME
   string
   default "libusb_hal"

endif

menuconfig REALTEK_XIAOWEI
   bool "xiaowei"
   help
      use xiaowei function
if REALTEK_XIAOWEI

config REALTEK_XIAOWEI_TARGET_NAME
   string
   default "libxiaowei"

endif

menuconfig REALTEK_MBEDTLS
   bool "MBEDTLS"
   help
      use MBEDTLS function

if REALTEK_MBEDTLS

config REALTEK_MBEDTLS_TARGET_NAME
   string
   default "MBEDTLS"

endif
```

## bin/rtl87x3e/flash_map_config/Kconfig
```kconfig
#
# Copyright (c) 2026, Realtek Semiconductor Corporation
#
# SPDX-License-Identifier: LicenseRef-Realtek-5-Clause
#
if SOC_SERIES_RTL8763E

choice REALTEK_FLASH_MAP
  prompt "flash map"
  default REALTEK_FLASH_MAP_4M
  help
    specify flash map header file directory

config REALTEK_FLASH_MAP_2M
   bool "2M flash map"
   help
     flash_2M

if REALTEK_FLASH_MAP_2M
config REALTEK_FLASH_MAP_PATH
   string
   default  "./bin/rtl87x3e/flash_map_config/2M/flash_2M"
endif

config REALTEK_FLASH_MAP_DURIAN_2M
   bool "2M durian flash map"
   help
     flash_durian_2M

if REALTEK_FLASH_MAP_DURIAN_2M
config REALTEK_FLASH_MAP_PATH
   string
   default "./bin/rtl87x3e/flash_map_config/2M/flash_durian_2M"
endif

config REALTEK_FLASH_MAP_4M
   bool "4M flash map"
   help
     flash_4M

if REALTEK_FLASH_MAP_4M
config REALTEK_FLASH_MAP_PATH
   string
   default "./bin/rtl87x3e/flash_map_config/4M/flash_4M"
endif

config REALTEK_FLASH_MAP_4M_GAMING
   bool "4M gaming flash map"
   help
     flash_4M_gaming

if REALTEK_FLASH_MAP_4M_GAMING

config REALTEK_FLASH_MAP_PATH
   string
   default "./bin/rtl87x3e/flash_map_config/4M/flash_4M_gaming"
endif
 
config REALTEK_FLASH_MAP_4M_SINGLE
   bool "4M single flash map"
   help
     flash_4M_single

if REALTEK_FLASH_MAP_4M_SINGLE
config REALTEK_FLASH_MAP_PATH
   string
   default "./bin/rtl87x3e/flash_map_config/4M_single"
endif

config REALTEK_FLASH_MAP_4M_GCC
   bool "4M GCC flash map"
   help
     flash_4M_gcc

if REALTEK_FLASH_MAP_4M_GCC

config REALTEK_FLASH_MAP_PATH
   string
   default "./bin/rtl87x3e/flash_map_config/4M/flash_4M"
endif

config REALTEK_FLASH_MAP_16M
   bool "16M flash map"
   help
     flash_16M

if REALTEK_FLASH_MAP_16M
config REALTEK_FLASH_MAP_PATH
   string
   default "./bin/rtl87x3e/flash_map_config/16M/flash_16M"
endif

config REALTEK_FLASH_MAP_32M_WATCH
   bool "32M watch flash map"
   help
     flash_32M_watch

if REALTEK_FLASH_MAP_32M_WATCH

config REALTEK_FLASH_MAP_PATH
   string
   default "./bin/rtl87x3e/flash_map_config/watch_flash_32M"
endif

config REALTEK_FLASH_MAP_CUSTOMIZED
   bool "customized flash map"
   help
     customized flash map directory

if REALTEK_FLASH_MAP_CUSTOMIZED
config REALTEK_FLASH_MAP_PATH
   string "customized flash map header file path"
   help
     set customized flash map header file directory
endif

endchoice


choice REALTEK_COMPILE_BANK
   prompt "bank type"
   default REALTEK_COMPILE_BANK0

config REALTEK_COMPILE_BANK0
   bool "bank 0"

config REALTEK_COMPILE_BANK1
   bool "bank 1"

endchoice

endif
```

## board/evb/audio_demo/Kconfig
```kconfig
#
# Copyright (c) 2026, Realtek Semiconductor Corporation
#
# SPDX-License-Identifier: LicenseRef-Realtek-5-Clause
#

config REALTEK_APP_AUDIO_DEMO
   bool 
   default y

rsource "../../../Kconfig"
```

## board/evb/ble_broadcaster/Kconfig
```kconfig
#
# Copyright (c) 2026, Realtek Semiconductor Corporation
#
# SPDX-License-Identifier: LicenseRef-Realtek-5-Clause
#

config REALTEK_APP_BLE_BROADCASTER
   bool 
   default y

rsource "../../../Kconfig"
```

## board/evb/ble_scatternet/Kconfig
```kconfig
#
# Copyright (c) 2026, Realtek Semiconductor Corporation
#
# SPDX-License-Identifier: LicenseRef-Realtek-5-Clause
#

config REALTEK_APP_BLE_SCATTERNET
   bool 
   default y

rsource "../../../Kconfig"
```

## board/evb/bt_audio_trx/Kconfig
```kconfig
#
# Copyright (c) 2026, Realtek Semiconductor Corporation
#
# SPDX-License-Identifier: LicenseRef-Realtek-5-Clause
#
mainmenu "realtek audiotrx mainmenu"

menu "audiotrx"

config REALTEK_APP_BT_AUDIO_TRI_DONGLE
   bool "BT_AUDIO_TRI_DONGLE"
   default n
   help
     BT Audio Tri-Dongle
	 
rsource "../../../src/Kconfig"
endmenu

config REALTEK_APP_BT_AUDIO_TRX
   bool 
   default y

rsource "../../../Kconfig"
```

## board/evb/bt_hid_demo/Kconfig
```kconfig
#
# Copyright (c) 2026, Realtek Semiconductor Corporation
#
# SPDX-License-Identifier: LicenseRef-Realtek-5-Clause
#

mainmenu "realtek hiddemo mainmenu"

menu "hiddemo"
rsource "../../../src/Kconfig"
endmenu

config REALTEK_BT_HID_DEMO_APP
   bool 
   default y

rsource "../../../Kconfig"
```

## board/evb/bt_iap_demo/Kconfig
```kconfig
#
# Copyright (c) 2026, Realtek Semiconductor Corporation
#
# SPDX-License-Identifier: LicenseRef-Realtek-5-Clause
#

mainmenu "realtek iapdemo mainmenu"

menu "iapdemo"
rsource "../../../src/Kconfig"
endmenu

config REALTEK_BT_IAP_DEMO_APP
   bool 
   default y

rsource "../../../Kconfig"
```

## board/evb/bt_map_demo/Kconfig
```kconfig
#
# Copyright (c) 2026, Realtek Semiconductor Corporation
#
# SPDX-License-Identifier: LicenseRef-Realtek-5-Clause
#

mainmenu "realtek mapdemo mainmenu"

menu "mapdemo"
rsource "../../../src/Kconfig"
endmenu

config REALTEK_BT_MAP_DEMO_APP
   bool 
   default y

rsource "../../../Kconfig"
```

## board/evb/bt_pan_demo/Kconfig
```kconfig
#
# Copyright (c) 2026, Realtek Semiconductor Corporation
#
# SPDX-License-Identifier: LicenseRef-Realtek-5-Clause
#

mainmenu "realtek pandemo mainmenu"

menu "pandemo"
rsource "../../../src/Kconfig"
endmenu

config REALTEK_BT_PAN_DEMO_APP
   bool 
   default y

rsource "../../../Kconfig"
```

## board/evb/bt_pbap_demo/Kconfig
```kconfig
#
# Copyright (c) 2026, Realtek Semiconductor Corporation
#
# SPDX-License-Identifier: LicenseRef-Realtek-5-Clause
#

mainmenu "realtek pbap demo mainmenu"

menu "pbap demo"
rsource "../../../src/Kconfig"
endmenu

config REALTEK_BT_PBAP_DEMO_APP
   bool 
   default y

rsource "../../../Kconfig"
```

## board/evb/bt_spp_demo/Kconfig
```kconfig
#
# Copyright (c) 2026, Realtek Semiconductor Corporation
#
# SPDX-License-Identifier: LicenseRef-Realtek-5-Clause
#

mainmenu "realtek spp demo mainmenu"

menu "spp demo"
rsource "../../../src/Kconfig"
endmenu

config REALTEK_BT_SPP_DEMO_APP
   bool 
   default y

rsource "../../../Kconfig"
```

## board/evb/io_demo/Kconfig
```kconfig
#
# Copyright (c) 2026, Realtek Semiconductor Corporation
#
# SPDX-License-Identifier: LicenseRef-Realtek-5-Clause
#

mainmenu "realtek iodemo mainmenu"

menu "iodemo"
rsource "../../../src/Kconfig"
endmenu

config REALTEK_IO_DEMO_APP
   bool
   default y

rsource "../../../Kconfig"
```

## board/evb/lea_cap_acceptor/Kconfig
```kconfig
#
# Copyright (c) 2026, Realtek Semiconductor Corporation
#
# SPDX-License-Identifier: LicenseRef-Realtek-5-Clause
#

config CONFIG_REALTEK_APP_LEA_CAP_ACCEPTOR 
   bool 
   default y

rsource "../../../Kconfig"
```

## board/evb/lib_template_demo/Kconfig
```kconfig
#
# Copyright (c) 2026, Realtek Semiconductor Corporation
#
# SPDX-License-Identifier: LicenseRef-Realtek-5-Clause
#
if REALTEK_TEMPLATE

config REALTEK_TEMPLATE_TARGET_NAME
    string
    default "template"
endif
```

## board/evb/lwip_lib/Kconfig
```kconfig
#
# Copyright (c) 2026, Realtek Semiconductor Corporation
#
# SPDX-License-Identifier: LicenseRef-Realtek-5-Clause
#
if REALTEK_LWIP

config REALTEK_LWIP_TARGET_NAME
   string
   default "liblwip"

endif
```

## board/evb/mbedtls_lib/Kconfig
```kconfig
#
# Copyright (c) 2026, Realtek Semiconductor Corporation
#
# SPDX-License-Identifier: LicenseRef-Realtek-5-Clause
#
if REALTEK_MBEDTLS

config REALTEK_MBEDTLS_TARGET_NAME
   string
   default "libmbedtls"

endif
```
